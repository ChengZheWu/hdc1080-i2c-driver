## yocto/meta-hdc1080/conf/layer.conf
```bitbake
BBPATH .= ":${LAYERDIR}"
BBFILES += "${LAYERDIR}/recipes-*/*/*.bb \
             ${LAYERDIR}/recipes-*/*/*.bbappend"
BBFILE_COLLECTIONS += "meta-hdc1080"
BBFILE_PATTERN_meta-hdc1080 = "^${LAYERDIR}/"
BBFILE_PRIORITY_meta-hdc1080 = "10"
LAYERSERIES_COMPAT_meta-hdc1080 = "scarthgap"
```
